## CMakeLists.txt
```
#
# Copyright (c) 2020 Nordic Semiconductor
#
# SPDX-License-Identifier: LicenseRef-Nordic-5-Clause
#

cmake_minimum_required(VERSION 3.13.1)

find_package(Zephyr REQUIRED HINTS $ENV{ZEPHYR_BASE})
project(nrf_cloud_rest_api)

# NORDIC SDK APP START
target_sources(app PRIVATE src/main.c)
target_sources(app PRIVATE src/modem_ncellmeas.c)
# NORDIC SDK APP END
```

## Kconfig
```
#
# Copyright (c) 2021 Nordic Semiconductor ASA
#
# SPDX-License-Identifier: LicenseRef-Nordic-5-Clause
#

menu "nRF Cloud REST API Sample"

config REST_SAMPLE_NAME
	string "Name of this sample, which is printed on startup"
	default "nRF Cloud REST API Sample"

config REST_JWT_SEC_TAG
	int "Security tag to use for generating JWTs"
	default 16842753

config REST_RETRY_WAIT_TIME_MIN
	int "Wait time, in minutes, before retrying (rebooting)"
	default 30

config REST_API_TOKEN
	string "API token which can be used instead of a JWT"

config REST_FOTA_ONLY
	bool "Only exercise FOTA APIs"

config REST_ENABLE_LED
	depends on DK_LIBRARY
	bool "Turn on LED when connected to network"
	default y

if REST_ENABLE_LED
config REST_LED_NUM
	int "LED number to use"
	default 0
endif

config REST_DO_JITP
	depends on DK_LIBRARY
	bool "Ask to perform just-in-time provisioning on startup"

if REST_DO_JITP
config REST_DO_JITP_BUTTON_NUM
	int "Button number to use for JITP request"
	default 1
endif

menu "nRF Cloud REST Device ID Source"
choice
	prompt "Device ID Source"
	default REST_ID_SRC_IMEI

config REST_ID_SRC_IMEI
	depends on NRF_MODEM_LIB
	bool "IMEI based value"

config REST_ID_SRC_COMPILE_TIME
	bool "Compile time value"

config REST_ID_SRC_INTERNAL_UUID
	bool "Modem internal UUID value"
	select MODEM_ATTEST_TOKEN
	select MODEM_ATTEST_TOKEN_PARSING
	help
	  Requires modem firmware version 1.3 or later.

endchoice

if REST_ID_SRC_IMEI
config REST_ID_PREFIX
	string "Prefix used when constructing the ID from the IMEI"
	default "nrf-"
	help
	  The nrf- prefix is reserved on nRF Connect for Cloud for official Nordic
	  devices (e.g. the nRF9160 DK or the Thingy:91).
endif

if REST_ID_SRC_COMPILE_TIME
config REST_DEVICE_ID
	string "ID used for connection to nRF Cloud"
	default ""
endif
endmenu # "Client ID"

endmenu

menu "Zephyr Kernel"
source "Kconfig.zephyr"
endmenu

module = NRF_CLOUD_REST_SAMPLE
module-str = nRF Cloud Rest Sample
source "${ZEPHYR_BASE}/subsys/logging/Kconfig.template.log_config"
```

## prj.conf
```kconfig
CONFIG_REST_ID_SRC_INTERNAL_UUID=y
CONFIG_REST_DO_JITP=n
CONFIG_REST_FOTA_ONLY=n
CONFIG_NRF_CLOUD_REST_HOST_NAME="api.nrfcloud.com"

CONFIG_NRF_CLOUD_REST_SAMPLE_LOG_LEVEL_DBG=y
CONFIG_NRF_CLOUD=y
CONFIG_FPU=y
CONFIG_NRF_CLOUD_REST=y
CONFIG_NRF_CLOUD_REST_LOG_LEVEL_DBG=y
CONFIG_NRF_CLOUD_CELL_POS=n
CONFIG_NRF_CLOUD_LOG_LEVEL_DBG=y
CONFIG_NEWLIB_LIBC=y
CONFIG_NEWLIB_LIBC_FLOAT_PRINTF=y
CONFIG_NEWLIB_LIBC_FLOAT_SCANF=y
CONFIG_ASSERT=y
CONFIG_REBOOT=y

CONFIG_FOTA_DOWNLOAD=y
CONFIG_FOTA_DOWNLOAD_PROGRESS_EVT=y
CONFIG_DFU_TARGET=y
CONFIG_DOWNLOAD_CLIENT=y

CONFIG_MODEM_JWT=y
CONFIG_NRF_MODEM_LIB_SYS_INIT=n

CONFIG_NETWORKING=y
CONFIG_NET_SOCKETS=y
CONFIG_NET_SOCKETS_POSIX_NAMES=y
CONFIG_NET_NATIVE=n

CONFIG_HEAP_MEM_POOL_SIZE=16384
CONFIG_MAIN_STACK_SIZE=8192

CONFIG_MODEM_KEY_MGMT=y
CONFIG_LTE_LINK_CONTROL=y
CONFIG_LTE_NETWORK_MODE_LTE_M=y
CONFIG_LTE_AUTO_INIT_AND_CONNECT=n

CONFIG_HTTP_CLIENT=y
CONFIG_BASE64=y

# Button support
CONFIG_DK_LIBRARY=y
CONFIG_DK_LIBRARY_INVERT_LEDS=n

# AT host library
CONFIG_AT_HOST_LIBRARY=y
CONFIG_UART_INTERRUPT_DRIVEN=y

CONFIG_LOG_BUFFER_SIZE=4096
CONFIG_LOG_STRDUP_MAX_STRING=4096
CONFIG_LOG_STRDUP_BUF_COUNT=24
CONFIG_NET_LOG=n
CONFIG_NET_HTTP_LOG_LEVEL_DBG=n

CONFIG_LOG=y
CONFIG_LOG_BUFFER_SIZE=4096
CONFIG_LOG_STRDUP_MAX_STRING=4096
CONFIG_LOG_STRDUP_BUF_COUNT=24
```

## src/main.c
```c
/*
 * Copyright (c) 2020 Nordic Semiconductor ASA
 *
 * SPDX-License-Identifier: LicenseRef-BSD-5-Clause-Nordic
 */

#include <zephyr.h>
#include <stdlib.h>
#include <stdio.h>
#include <net/socket.h>
#include <net/net_ip.h>
#include <modem/nrf_modem_lib.h>
#include <modem/at_cmd.h>
#include <modem/at_notif.h>
#include <net/tls_credentials.h>
#include <modem/modem_key_mgmt.h>
#include <net/http_client.h>
#include <sys/base64.h>
#include <net/nrf_cloud_rest.h>
#include <modem/modem_jwt.h>
#include <power/reboot.h>
#include <logging/log.h>
#include <dk_buttons_and_leds.h>
#include <net/fota_download.h>

#if defined(CONFIG_REST_ID_SRC_COMPILE_TIME)
BUILD_ASSERT(sizeof(CONFIG_REST_DEVICE_ID) > 1, "Device ID must be specified");
#elif defined(CONFIG_REST_ID_SRC_IMEI)
#define CGSN_RSP_LEN 19
#define IMEI_LEN 15
#define IMEI_CLIENT_ID_LEN (sizeof(CONFIG_REST_ID_PREFIX) \
			    - 1 + IMEI_LEN)
BUILD_ASSERT(IMEI_CLIENT_ID_LEN <= NRF_CLOUD_CLIENT_ID_MAX_LEN,
	"REST_ID_PREFIX plus IMEI must not exceed NRF_CLOUD_CLIENT_ID_MAX_LEN");
#endif

LOG_MODULE_REGISTER(rest_sample, CONFIG_NRF_CLOUD_REST_SAMPLE_LOG_LEVEL);

#define FOTA_DL_FRAGMENT_SZ 1400
#define REST_RX_BUF_SZ	2100
#define BUTTON_EVENT_BTN_NUM CONFIG_REST_BUTTON_EVT_NUM
#define LED_NUM CONFIG_REST_LED_NUM
#define JITP_REQ_WAIT_SEC 10
#define NCELL_MEAS_CNT 17

const char * const FOTA_STATUS_DETAILS_TIMEOUT = "Download did not complete in the alloted time";
const char * const FOTA_STATUS_DETAILS_DL_ERR  = "Error occured while downloading the file";
const char * const FOTA_STATUS_DETAILS_MDM_REJ = "Modem rejected the update; invalid delta?";
const char * const FOTA_STATUS_DETAILS_MCU_REJ = "Device rejected the update";
const char * const FOTA_STATUS_DETAILS_SUCCESS = "FOTA update completed successfully";

static char device_id[NRF_CLOUD_CLIENT_ID_MAX_LEN + 1];

static K_SEM_DEFINE(fota_download_sem, 0, 1);
static K_SEM_DEFINE(button_press_sem, 0, 1);
static K_SEM_DEFINE(lte_connected, 0, 1);
static K_SEM_DEFINE(cell_data_ready, 0, 1);

static struct lte_lc_ncell neighbor_cells[NCELL_MEAS_CNT];
static struct lte_lc_cells_info cell_data = {
	.neighbor_cells = neighbor_cells,
};
static atomic_t waiting_for_ncell;

static enum nrf_cloud_fota_status fota_status = NRF_CLOUD_FOTA_CANCELED;
static struct nrf_cloud_fota_job_info job;

#if defined(CONFIG_REST_DO_JITP)
static bool jitp_requested;
#endif

static char const * fota_status_details = FOTA_STATUS_DETAILS_SUCCESS;

static int set_device_id(void)
{
	int err = 0;

#if defined(CONFIG_REST_ID_SRC_COMPILE_TIME)

	memcpy(device_id, CONFIG_REST_DEVICE_ID, strlen(CONFIG_REST_DEVICE_ID));
	return 0;

#elif defined(CONFIG_REST_ID_SRC_IMEI)

	char imei_buf[CGSN_RSP_LEN + 1];
	err = at_cmd_write("AT+CGSN", imei_buf, sizeof(imei_buf), NULL);
	if (err) {
		LOG_ERR("Failed to obtain IMEI, error: %d", err);
		return err;
	}

	imei_buf[IMEI_LEN] = 0;

	err = snprintk(device_id, sizeof(device_id), "%s%.*s",
		       CONFIG_REST_ID_PREFIX,
		       IMEI_LEN, imei_buf);
	if (err < 0 || err >= sizeof(device_id)) {
		return -EIO;
	}

	return 0;

#elif defined(CONFIG_REST_ID_SRC_INTERNAL_UUID)

	struct nrf_device_uuid dev_id;

	err = modem_jwt_get_uuids(&dev_id, NULL);
	if (err) {
		LOG_ERR("Failed to get device UUID: %d", err);
		return err;
	}
	memcpy(device_id, dev_id.str, sizeof(dev_id.str));

	return 0;

#endif

	return -ENOTRECOVERABLE;
}

static void http_fota_handler(const struct fota_download_evt *evt)
{
	LOG_DBG("evt: %d", evt->id);

	switch (evt->id) {
	case FOTA_DOWNLOAD_EVT_FINISHED:
		LOG_INF("FOTA complete");
		k_sem_give(&fota_download_sem);
		fota_status = NRF_CLOUD_FOTA_SUCCEEDED;
		break;
	case FOTA_DOWNLOAD_EVT_ERASE_PENDING:
		LOG_INF("FOTA complete");
		fota_status = NRF_CLOUD_FOTA_SUCCEEDED;
		k_sem_give(&fota_download_sem);
		break;
	case FOTA_DOWNLOAD_EVT_ERASE_DONE:
		break;
	case FOTA_DOWNLOAD_EVT_ERROR:
		LOG_INF("FOTA download error: %d", evt->cause);

		fota_status = NRF_CLOUD_FOTA_FAILED;
		fota_status_details = FOTA_STATUS_DETAILS_DL_ERR;

		if (evt->cause == FOTA_DOWNLOAD_ERROR_CAUSE_INVALID_UPDATE) {
			fota_status = NRF_CLOUD_FOTA_REJECTED;
			if (job.type == NRF_CLOUD_FOTA_MODEM) {
				fota_status_details = FOTA_STATUS_DETAILS_MDM_REJ;
			} else {
				fota_status_details = FOTA_STATUS_DETAILS_MCU_REJ;
			}
		}
		k_sem_give(&fota_download_sem);
		break;
	case FOTA_DOWNLOAD_EVT_PROGRESS:
		LOG_INF("FOTA download percent: %d", evt->progress);
		break;
	default:
		break;
	}
}

int set_led(const int state)
{
#if defined(CONFIG_REST_ENABLE_LED)
#if defined(CONFIG_BOARD_CIRCUITDOJO_FEATHER_NRF9160NS) || \
    defined(CONFIG_BOARD_CIRCUITDOJO_FEATHER_NRF9160)
	int err = dk_set_led(LED_NUM, !state);
#else
	int err = dk_set_led(LED_NUM, state);
#endif

	if (err) {
		LOG_ERR("Failed to set LED, error: %d", err);
		return err;
	}
#else
	ARG_UNUSED(state);
#endif
	return 0;
}

int init_led(void)
{
#if defined(CONFIG_REST_ENABLE_LED)
	int err = dk_leds_init();
	if (err)
	{
		LOG_ERR("LED init failed, error: %d", err);
		return err;
	}
	(void)set_led(0);
#endif
	return 0;
}

static void button_handler(uint32_t button_states, uint32_t has_changed)
{
	if (has_changed & button_states &
	    BIT(BUTTON_EVENT_BTN_NUM - 1)) {

		LOG_DBG("Button %d pressed", BUTTON_EVENT_BTN_NUM);
		k_sem_give(&button_press_sem);

		if (atomic_get(&waiting_for_ncell)) {
			atomic_set(&waiting_for_ncell, 0);
			k_sem_give(&cell_data_ready);
		}
	}
}

static int request_jitp(void)
{
	int ret = 0;

#if defined(CONFIG_REST_DO_JITP)
	jitp_requested = false;

	(void)k_sem_take(&button_press_sem, K_NO_WAIT);

	LOG_INF("Press button %d to request just-in-time provisioning", BUTTON_EVENT_BTN_NUM);
	LOG_INF("Waiting %d seconds..", JITP_REQ_WAIT_SEC);

	ret = k_sem_take(&button_press_sem, K_SECONDS(JITP_REQ_WAIT_SEC));
	if (ret == -EAGAIN) {
		LOG_INF("JITP will be skipped");
		ret = 0;
	} else if (ret) {
		LOG_ERR("k_sem_take: err %d", ret);
	} else {
		jitp_requested = true;
		LOG_INF("JITP will be performed after network connection is obtained");
		ret = 0;
	}
#endif
	return ret;
}

static int do_jitp(void)
{
	int ret = 0;

#if defined(CONFIG_REST_DO_JITP)
	if (!jitp_requested) {
		return 0;
	}

	LOG_INF("Performing JITP..");
	ret = nrf_cloud_rest_jitp(CONFIG_NRF_CLOUD_SEC_TAG);

	if (ret == 0) {
		LOG_INF("Waiting 30s for cloud provisioning to complete..");
		k_sleep(K_SECONDS(30));
		(void)k_sem_take(&button_press_sem, K_NO_WAIT);
		LOG_INF("Associate device with nRF Cloud account and press button %d when complete",
			BUTTON_EVENT_BTN_NUM);
		(void)k_sem_take(&button_press_sem, K_FOREVER);
	} else if (ret == 1) {
		LOG_INF("Device already provisioned");
	} else {
		LOG_ERR("Device provisioning failed");
	}
#endif
	return ret;
}

int init(void)
{
	int err = init_led();

	if (err){
		LOG_ERR("LED init failed");
		return err;
	}

	err = nrf_modem_lib_init(NORMAL_MODE);
	if (err) {
		LOG_ERR("Failed to initialize modem library: %d", err);
		LOG_ERR("This can occur after a modem FOTA.");
		return err;
	}

	err = at_cmd_init();
	if (err) {
		LOG_ERR("Failed to initialize AT commands, err %d", err);
		return err;
	}

	err = at_notif_init();
	if (err) {
		LOG_ERR("Failed to initialize AT notifications, err %d", err);
		return err;
	}

	err = set_device_id();
	if (err) {
		LOG_ERR("Failed to set device ID, err %d", err);
		return err;
	}

	LOG_INF("Device ID: %s", log_strdup(device_id));

	err = dk_buttons_init(button_handler);
	if (err) {
		LOG_ERR("Failed to initialize button: err %d", err);
		return err;
	}

	err = request_jitp();
	if (err){
		LOG_WRN("User JITP request failed");
		err = 0;
	}

	return 0;
}

static void lte_handler(const struct lte_lc_evt *const evt)
{
	switch (evt->type) {
	case LTE_LC_EVT_NW_REG_STATUS:
		LOG_DBG("LTE_LC_EVT_NW_REG_STATUS: %d", evt->nw_reg_status);
		if ((evt->nw_reg_status != LTE_LC_NW_REG_REGISTERED_HOME) &&
		     (evt->nw_reg_status != LTE_LC_NW_REG_REGISTERED_ROAMING)) {
			break;
		}

		LOG_INF("Network registration status: %s",
			evt->nw_reg_status == LTE_LC_NW_REG_REGISTERED_HOME ?
			"Connected - home network" : "Connected - roaming");
		k_sem_give(&lte_connected);
		break;
	case LTE_LC_EVT_CELL_UPDATE:
		LOG_DBG("LTE cell changed: Cell ID: %d, Tracking area: %d",
			evt->cell.id, evt->cell.tac);
		cell_data.current_cell = evt->cell;
		break;
	case LTE_LC_EVT_NEIGHBOR_CELL_MEAS:
		LOG_INF("Neighbor cell measurements received");

		/* Copy current and neighbor cell information. */
		memcpy(&cell_data, &evt->cells_info, sizeof(struct lte_lc_cells_info));
		memcpy(neighbor_cells, evt->cells_info.neighbor_cells,
			sizeof(struct lte_lc_ncell) * cell_data.ncells_count);
		cell_data.neighbor_cells = neighbor_cells;

		k_sem_give(&cell_data_ready);
		break;
	case LTE_LC_EVT_LTE_MODE_UPDATE:
	case LTE_LC_EVT_PSM_UPDATE:
	case LTE_LC_EVT_EDRX_UPDATE:
	case LTE_LC_EVT_RRC_UPDATE:
	default:
		break;
	}
}

static int connect_to_network(void)
{
	int err;

	LOG_INF("Waiting for network..");

	(void)k_sem_take(&lte_connected, K_NO_WAIT);

	err = lte_lc_init_and_connect_async(lte_handler);
	if (err) {
		LOG_ERR("Failed to init modem, err %d", err);
	} else {
		k_sem_take(&lte_connected, K_FOREVER);
		LOG_INF("Connected");
		(void)set_led(1);
	}

	return err;
}

void main(void)
{
	LOG_INF("Starting \"%s\"..", log_strdup(CONFIG_REST_SAMPLE_NAME));

	char rx_buf[REST_RX_BUF_SZ];
	int agps_sz;
	struct nrf_cloud_cell_pos_result location;
	struct jwt_data jwt = {
#if defined(CONFIG_REST_ID_SRC_INTERNAL_UUID)
		.subject = NULL,
#else
		.subject = device_id,
#endif
		.audience = NULL,
		.exp_delta_s = 0,
		.sec_tag = CONFIG_REST_JWT_SEC_TAG,
		.key = JWT_KEY_TYPE_CLIENT_PRIV,
		.alg = JWT_ALG_TYPE_ES256
	};
	struct nrf_cloud_rest_context rest_ctx = {
		.connect_socket = -1,
		.keep_alive = true,
		.timeout_ms = 30000,
		.rx_buf = rx_buf,
		.rx_buf_len = sizeof(rx_buf),
		.fragment_size = 0
	};
	struct nrf_cloud_rest_cell_pos_request loc_req;
	struct nrf_cloud_rest_agps_request agps_req = {
		.type = NRF_CLOUD_REST_AGPS_REQ_CUSTOM
	};
	struct gps_agps_request agps = {
		.utc = 1,
		.sv_mask_ephe = 1,
		.sv_mask_alm = 1,
		.klobuchar = 1
	};
	struct nrf_cloud_rest_agps_result agps_result = {
		.buf_sz = 0,
		.buf = NULL
	};

	struct gps_pgps_request pgps = {
		.gps_day = 15103,
		.prediction_count = 42,
		.prediction_period_min = 420,
		.gps_time_of_day = 0
	};

	struct nrf_cloud_rest_pgps_request pgps_request;

	int err = init();

	if (err)
	{
		LOG_ERR("Initialization failed");
		goto cleanup;
	}

	err = connect_to_network();
	if (err){
		goto cleanup;
	}

	lte_lc_neighbor_cell_measurement();

	(void)do_jitp();

retry:

	err = modem_jwt_generate(&jwt);
	if (err) {
		LOG_ERR("Failed to generate JWT, err %d", err);
		goto cleanup;
	}
	LOG_DBG("JWT:\n%s", log_strdup(jwt.jwt_buf));
	rest_ctx.auth = jwt.jwt_buf;

	if (IS_ENABLED(CONFIG_REST_FOTA_ONLY)) {
		goto fota_start;
	}

	LOG_INF("\n******************* Locate API *******************");

	size_t sem_cnt = k_sem_count_get(&cell_data_ready);
	if (!sem_cnt) {
		k_sem_take(&button_press_sem, K_NO_WAIT);
		atomic_set(&waiting_for_ncell, 1);
		LOG_INF("Waiting for cell data, press button %d to skip..",
			BUTTON_EVENT_BTN_NUM);

		err = k_sem_take(&cell_data_ready, K_FOREVER);

		if (err || !atomic_get(&waiting_for_ncell)) {
			LOG_INF("Skipping locate");
			loc_req.net_info = NULL;
			goto pgps_start;
		}
	}

	loc_req.net_info = &cell_data;
	err = nrf_cloud_rest_cell_pos_get(&rest_ctx, &loc_req, &location);
	if (err) {
		LOG_ERR("Cell Pos API call failed, error: %d", err);
	} else {
		LOG_INF("Cell Pos Response: %s", log_strdup(rest_ctx.response));
	}

pgps_start:
	/* Exercise P-GPS API */
	LOG_INF("\n********************* P-GPS API *********************");

	pgps_request.pgps_req = &pgps;

	err = nrf_cloud_rest_pgps_data_get(&rest_ctx, &pgps_request);
	if (err) {
		LOG_ERR("P-GPS request failed, error: %d", err);
	}

	/* Exercise A-GPS API */
	LOG_INF("\n********************* A-GPS API *********************");

	agps_req.net_info = loc_req.net_info;
	agps_req.agps_req = &agps;
	/* When requesting a potentially large result, set fragment size to a
	 * small value (1) and do not provide a result buffer.
	 * This will allow you to obtain the necessary size while limiting
	 * data transfer.
	 */
	rest_ctx.fragment_size = 1;
	agps_sz = nrf_cloud_rest_agps_data_get(&rest_ctx, &agps_req, NULL);
	if (agps_sz < 0) {
		LOG_ERR("Failed to get A-GPS data: %d", agps_sz);
		goto fota_start;
	} else if (agps_sz == 0) {
		LOG_WRN("A-GPS data size is zero, skipping");
		goto fota_start;
	}

	LOG_INF("Additional buffer required to download A-GPS data of %d bytes",
		agps_sz);

	agps_result.buf_sz = (uint32_t)agps_sz;
	agps_result.buf = k_calloc(agps_result.buf_sz, 1);
	if (!agps_result.buf) {
		LOG_ERR("Failed to allocate %u bytes for A-GPS buffer", agps_result.buf_sz);
		goto fota_start;
	}
	/* Use the default configured fragment size */
	rest_ctx.fragment_size = 0;
	err = nrf_cloud_rest_agps_data_get(&rest_ctx, &agps_req, &agps_result);
	if (err) {
		LOG_ERR("Failed to get A-GPS data: %d", err);
	} else {
		/* Send the A-GPS result buffer to the modem using
		 * gps_process_agps_data() or nrf_cloud_agps_process()
		 */
		LOG_INF("Successfully received A-GPS data");
	}

	k_free(agps_result.buf);
	agps_result.buf = NULL;

fota_start:
	LOG_INF("\n******************* FOTA API *******************");

	/* Exercise the FOTA API by checking for a job
	 * and if a job exists, mark it as cancelled.
	 */
	err = nrf_cloud_rest_fota_job_get(&rest_ctx, device_id, &job);
	if (err) {
		LOG_INF("Failed to fetch FOTA job, error: %d", err);
		goto cleanup;
	}

	if (job.type == NRF_CLOUD_FOTA_TYPE__INVALID) {
		LOG_INF("No pending FOTA job");
		goto cleanup;
	}

	LOG_INF("FOTA Job: %s, type: %d\n", log_strdup(job.id), job.type);

	int ret = fota_download_init(http_fota_handler);

	if (ret != 0) {
		LOG_ERR("fota_download_init error: %d", ret);
		return;
	}

	ret = fota_download_start(job.host, job.path,
		CONFIG_REST_JWT_SEC_TAG, NULL, FOTA_DL_FRAGMENT_SZ);

	ret = k_sem_take(&fota_download_sem, K_MINUTES(15));
	if (ret == 0) {
		LOG_INF("FOTA download complete");
		k_sleep(K_SECONDS(5));
	} else if (ret == -EAGAIN) {
		fota_download_cancel();
		LOG_INF("FOTA download timed out");
		fota_status = NRF_CLOUD_FOTA_TIMED_OUT;
		fota_status_details = FOTA_STATUS_DETAILS_TIMEOUT;
	} else {
		goto cleanup;
	}

	/* Disconnect after next API call */
	rest_ctx.keep_alive = false;

	/* Update the job */
	err = nrf_cloud_rest_fota_job_update(&rest_ctx, device_id,
		job.id, fota_status, fota_status_details);

	if (err) {
		LOG_ERR("Failed to update FOTA job, error: %d", err);
	} else {
		LOG_INF("FOTA job updated, status: %d", fota_status);
	}

cleanup:
	(void)nrf_cloud_rest_disconnect(&rest_ctx);
	modem_jwt_free(jwt.jwt_buf);
	jwt.jwt_buf = NULL;
	nrf_cloud_rest_fota_job_free(&job);

	if (err) {
		LOG_INF("Rebooting in 30s..");
		k_sleep(K_SECONDS(30));
	} else if (fota_status == NRF_CLOUD_FOTA_SUCCEEDED) {
		LOG_INF("Rebooting in 30s to complete FOTA update..");
		k_sleep(K_SECONDS(30));
	} else {
		LOG_INF("Retrying in %d minute(s)..",
			CONFIG_REST_RETRY_WAIT_TIME_MIN);
		k_sleep(K_MINUTES(CONFIG_REST_RETRY_WAIT_TIME_MIN));
		goto retry;
	}

	sys_reboot(SYS_REBOOT_COLD);
}
```

## src/modem_ncellmeas.c
```c
/*
 * Copyright (c) 2020 Nordic Semiconductor ASA
 *
 * SPDX-License-Identifier: LicenseRef-BSD-5-Clause-Nordic
 */

#include <string.h>
#include <zephyr.h>
#include <stdlib.h>
#include <stdio.h>
#include <modem/nrf_modem_lib.h>
#include <modem/at_cmd.h>
#include <cJSON.h>
#include <cJSON_os.h>
#include "modem_ncellmeas.h"

#define AT_CMD_N_CELL_MEAS	"AT%NCELLMEAS\r\n"
#define N_CELL_MEAS_DATA_NAME	"nCellMeasure"

#define ITEMS_PER_NEIGHBOR	5
#define N_CELL_MEAS_MIN_ITEMS	9
#define N_CELL_MEAS_MAX_ITEMS	(N_CELL_MEAS_MIN_ITEMS + \
				(ITEMS_PER_NEIGHBOR * MAX_N_CELLS))
#define N_CELL_MEAS_STATUS_IDX	0
#define N_CELL_MEAS_CID_IDX	1 // hex string
#define N_CELL_MEAS_MCCMNC_IDX	2 // hex string
#define N_CELL_MEAS_TAC_IDX	3 // hex string
#define N_CELL_MEAS_TIM_ADV_IDX	4
#define N_CELL_MEAS_EARFCN_IDX	5
#define N_CELL_MEAS_PHYCID_IDX  6
#define N_CELL_MEAS_RSRP_IDX  7
#define N_CELL_MEAS_RSRQ_IDX  8
#define N_CELL_MEAS_N_EARFCN_IDX 9
#define N_CELL_MEAS_N_PHYCID_IDX 10
#define N_CELL_MEAS_N_RSRP_IDX 11
#define N_CELL_MEAS_N_RSRQ_IDX 12
#define N_CELL_MEAS_N_TDIFF_IDX 13

#define CELL_ID_HEX_STR_LEN	8
#define TAC_HEX_STR_LEN		4
#define MCCMNC_STR_LEN		6
#define MCC_STR_LEN		3

#define N_CELL_MEAS_CMD_RSP_MAX_SZ	1024

static int parse_n_cell_meas_json(cJSON * const obj, struct n_cell_measure_result * const result)
{
	__ASSERT_NO_MSG(obj);
	__ASSERT_NO_MSG(result);

	int item_cnt;
	char buff[MCC_STR_LEN + 1];
	cJSON * item;

	if (!cJSON_IsArray(obj)) {
		return -ENOSTR;
	}

	/* Verify item count */
	item_cnt = cJSON_GetArraySize(obj);
	if (item_cnt == (N_CELL_MEAS_MIN_ITEMS + 1)) {
		/* ??? There is a trailing zero if no neigbors ??? */
		result->n_cnt = 0;
	} else if (item_cnt < N_CELL_MEAS_MIN_ITEMS || item_cnt > N_CELL_MEAS_MAX_ITEMS ||
		   (((item_cnt - N_CELL_MEAS_MIN_ITEMS) % ITEMS_PER_NEIGHBOR) != 0)) {
		return -ECHILD;
	} else {
		result->n_cnt = ((item_cnt - N_CELL_MEAS_MIN_ITEMS) /
				ITEMS_PER_NEIGHBOR);
	}

	/* Get status of n cell measure cmd */
	item = cJSON_GetArrayItem(obj, N_CELL_MEAS_STATUS_IDX);
	if (!item || !cJSON_IsNumber(item)) {
		return -ENOEXEC;
	}
	result->status = item->valueint;
	if (result->status == N_CELL_MEAS_N_STATUS_FAIL) {
		/* Nothing more to process */
		return 0;
	}

	/* Get Cell ID hex string and convert to int */
	item = cJSON_GetArrayItem(obj, N_CELL_MEAS_CID_IDX);
	if (!item || !cJSON_IsString(item) ||
	    strlen(item->valuestring) > CELL_ID_HEX_STR_LEN) {
		return -ENOEXEC;
	}
	result->cell_id = (uint32_t)strtol(item->valuestring, NULL, 16);

	/* Get 3 digit MCC and 2-3 digit MNC string and convert to int  */
	item = cJSON_GetArrayItem(obj, N_CELL_MEAS_MCCMNC_IDX);
	if (!item || !cJSON_IsString(item) ||
	    strlen(item->valuestring) > MCCMNC_STR_LEN) {
		return -ENOEXEC;
	}
	memcpy(buff, item->valuestring, MCC_STR_LEN);
	buff[MCC_STR_LEN] = '\0';
	result->mcc = strtol(buff, NULL, 10);
	result->mnc = strtol(&item->valuestring[MCC_STR_LEN], NULL, 10);

	/* Get TAC hex string and convert to int */
	item = cJSON_GetArrayItem(obj, N_CELL_MEAS_TAC_IDX);
	if (!item || !cJSON_IsString(item) ||
	    strlen(item->valuestring) > TAC_HEX_STR_LEN) {
		return -ENOEXEC;
	}
	result->area_code = (uint16_t)strtol(item->valuestring, NULL, 16);

	/* Get timing advance */
	item = cJSON_GetArrayItem(obj, N_CELL_MEAS_TIM_ADV_IDX);
	if (!item || !cJSON_IsNumber(item)) {
		return -ENOEXEC;
	}
	result->timing_adv = (uint16_t)item->valueint;

	/* Get EARFN */
	item = cJSON_GetArrayItem(obj, N_CELL_MEAS_EARFCN_IDX);
	if (!item || !cJSON_IsNumber(item)) {
		return -ENOEXEC;
	}
	result->cur_data.earfcn = (uint32_t)item->valueint;

	/* Get physical cell ID */
	item = cJSON_GetArrayItem(obj, N_CELL_MEAS_PHYCID_IDX);
	if (!item || !cJSON_IsNumber(item)) {
		return -ENOEXEC;
	}
	result->cur_data.phy_cell_id = (uint32_t)item->valueint;

	/* Get RSRP */
	item = cJSON_GetArrayItem(obj, N_CELL_MEAS_RSRP_IDX);
	if (!item || !cJSON_IsNumber(item)) {
		return -ENOEXEC;
	}
	result->cur_data.rsrp = (int8_t)item->valueint;

	/* Get RSRQ */
	item = cJSON_GetArrayItem(obj, N_CELL_MEAS_RSRQ_IDX);
	if (!item || !cJSON_IsNumber(item)) {
		return -ENOEXEC;
	}
	result->cur_data.rsrq = (int8_t)item->valueint;

	/* Get all neighbor data */
	for (uint8_t cnt = 0; cnt < result->n_cnt; ++cnt) {
		int idx = N_CELL_MEAS_MIN_ITEMS + (cnt * ITEMS_PER_NEIGHBOR);

		/* Neighbor data is in the following order:
		 * EARFN, Physical cell id, RSRP, RSRQ, Time diff
		 */
		item = cJSON_GetArrayItem(obj, idx++);
		if (!item || !cJSON_IsNumber(item)) {
			return -ENOEXEC;
		}
		result->nghbr[cnt].data.earfcn = (uint32_t)item->valueint;

		item = cJSON_GetArrayItem(obj, idx++);
		if (!item || !cJSON_IsNumber(item)) {
			return -ENOEXEC;
		}
		result->nghbr[cnt].data.phy_cell_id = (uint32_t)item->valueint;

		item = cJSON_GetArrayItem(obj, idx++);
		if (!item || !cJSON_IsNumber(item)) {
			return -ENOEXEC;
		}
		result->nghbr[cnt].data.rsrp = (int8_t)item->valueint;

		item = cJSON_GetArrayItem(obj, idx++);
		if (!item || !cJSON_IsNumber(item)) {
			return -ENOEXEC;
		}
		result->nghbr[cnt].data.rsrq = (int8_t)item->valueint;

		item = cJSON_GetArrayItem(obj, idx);
		if (!item || !cJSON_IsNumber(item)) {
			return -ENOEXEC;
		}
		result->nghbr[cnt].time_diff_ms = (uint32_t)item->valueint;
	}

	return 0;
}

int modem_get_neighboring_cell_data(struct n_cell_measure_result * const result)
{
	if (!result) {
		return -EINVAL;
	}

	int ret = 0;
	enum at_cmd_state state;
	cJSON * result_obj = NULL;
	char * cmd_resp = NULL;
	char * json_start;
	char * json_end;

	ret = at_cmd_init();
	if (ret) {
		return -EPIPE;
	}

	/* Allocate response buffer and send cmd */
	cmd_resp = k_calloc(N_CELL_MEAS_CMD_RSP_MAX_SZ, 1);
	if (!cmd_resp) {
		ret = -ENOMEM;
		goto cleanup;
	}

	ret = at_cmd_write(AT_CMD_N_CELL_MEAS, cmd_resp,
			   N_CELL_MEAS_CMD_RSP_MAX_SZ, &state);
	if (ret) {
		ret = -EBADMSG;
		goto cleanup;
	}

	json_start = strchr(cmd_resp,' ');
	if (!json_start) {
		ret = -ENOMSG;
		goto cleanup;
	}

	json_end = strchr(json_start,'\r');
	if (!json_end) {
		ret = -ENOMSG;
		goto cleanup;
	}

	/* Reformat into JSON array */
	*json_start = '[';
	*json_end = ']';
	*(json_end + 1) = '\0';

	cJSON_Init();
	result_obj = cJSON_Parse(json_start);
	if (!result_obj) {
		ret = -ENOMSG;
		goto cleanup;
	}

	ret = parse_n_cell_meas_json(result_obj, result);

cleanup:

	if (cmd_resp) {
		k_free(cmd_resp);
	}

	if (result_obj) {
		cJSON_Delete(result_obj);
	}

	return ret;
}
```

## src/modem_ncellmeas.h
```c
/*
 * Copyright (c) 2021 Nordic Semiconductor ASA
 *
 * SPDX-License-Identifier: LicenseRef-Nordic-5-Clause
 */

/**
 * @file modem_ncellmeas.h
 *
 * @brief Execute and process the command AT%NCELLMEAS
 *
 */
#ifndef MODEM_NCELLMEAS_H__
#define MODEM_NCELLMEAS_H__

#include <zephyr/types.h>

#ifdef __cplusplus
extern "C" {
#endif

#define MAX_N_CELLS 17
#define N_CELL_MEAS_N_STATUS_PASS 0
#define N_CELL_MEAS_N_STATUS_FAIL 1

struct cell_data {
	uint32_t earfcn;
	uint32_t phy_cell_id;
	int8_t rsrp;
	int8_t rsrq;
};

struct neighbor_data {
	struct cell_data data;
	uint32_t time_diff_ms;
};

/** @brief Neighboring cell mesurement results */
struct n_cell_measure_result {
	/** Status result of command */
	uint8_t status;
	/** Connected cell information */
	uint32_t cell_id;
	uint16_t mcc;
	uint16_t mnc;
	uint16_t area_code;
	uint16_t timing_adv;
	struct cell_data cur_data;
	/** Number of neighbors in n_cell_data */
	uint8_t n_cnt;
	/** Neighbor cell information */
	struct neighbor_data nghbr[MAX_N_CELLS];
};

/**
 * @brief Executes the NCELLMEAS AT command and parses the result into the
 *        provided structure.
 *
 * @param[out] result Results from NCELLMEAS AT command.
 *
 * @retval 0 If the operation was successful.
 *           Otherwise, a (negative) error code is returned.
 */
int modem_get_neighboring_cell_data(struct n_cell_measure_result * const result);

/** @} */

#ifdef __cplusplus
}
#endif

#endif /* MODEM_NCELLMEAS_H__ */
```
