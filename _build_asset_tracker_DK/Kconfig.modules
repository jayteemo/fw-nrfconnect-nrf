## _build_asset_tracker_DK/Kconfig.modules
```kconfig
osource "/Users/justin/Github/FORKS/WIP_interval_cmds/nrf/Kconfig.nrf"

osource "/Users/justin/Github/FORKS/WIP_interval_cmds/mcuboot/zephyr/Kconfig"

osource "/Users/justin/Github/FORKS/WIP_interval_cmds/nrfxlib/Kconfig.nrfxlib"
```

## _build_asset_tracker_DK/Kconfig/Kconfig.modules
```kconfig
osource "/Users/justin/Github/FORKS/fota_v2/nrf/Kconfig.nrf"

osource "/Users/justin/Github/FORKS/fota_v2/bootloader/mcuboot/zephyr/Kconfig"

osource "/Users/justin/Github/FORKS/fota_v2/nrfxlib/Kconfig.nrfxlib"
```

## _build_asset_tracker_DK/spm/Kconfig/Kconfig.soc.arch
```kconfig
osource "/Users/justin/Github/FORKS/fota_v2/zephyr/soc/$(ARCH)/Kconfig"
osource "/Users/justin/Github/FORKS/fota_v2/zephyr/soc/$(ARCH)/*/Kconfig"
```

## lib/modem_attest_token/Kconfig
```kconfig
#
# Copyright (c) 2021 Nordic Semiconductor
#
# SPDX-License-Identifier: LicenseRef-Nordic-5-Clause
#

menuconfig MODEM_ATTEST_TOKEN
	bool "Modem Attestation Token Library"
	select NRF_MODEM_LIB
	select AT_CMD
	help
		Functionality requires modem firmware version 1.3 or greater.

if MODEM_ATTEST_TOKEN

config MODEM_ATTEST_TOKEN_PARSING
	bool "Enable parsing of the attestation token"
	select TINYCBOR
	select BASE64
	default y

module=MODEM_ATTEST_TOKEN
module-str=Modem Attestation Token

endif # MODEM_ATTEST_TOKEN
```

## lib/service_info/Kconfig
```kconfig
#
# Copyright (c) 2019 Nordic Semiconductor
#
# SPDX-License-Identifier: LicenseRef-BSD-5-Clause-Nordic
#

menuconfig SERVICE_INFO
	bool "nRF91 service information library"
	default y

if SERVICE_INFO
endif # MODEM_INFO
```

## samples/cellular/smp_svr/sysbuild/mcuboot/boards/thingy91x_nrf5340_cpuapp.conf
```kconfig
CONFIG_MCUBOOT_SERIAL=y
CONFIG_BOOT_MGMT_ECHO=y
CONFIG_MCUBOOT_SERIAL_DIRECT_IMAGE_UPLOAD=y
CONFIG_BOOT_SERIAL_UART=y
CONFIG_BOOT_SERIAL_WAIT_FOR_DFU=y
CONFIG_BOOT_SERIAL_WAIT_FOR_DFU_TIMEOUT=2000
CONFIG_BOOT_SERIAL_IMG_GRP_IMAGE_STATE=y
CONFIG_UPDATEABLE_IMAGE_NUMBER=1
```

## subsys/net/lib/nrf_cloud/Kconfig
```kconfig
# Copyright (c) 2018 Nordic Semiconductor
#
# SPDX-License-Identifier: LicenseRef-Nordic-5-Clause
#

menu "nRF Cloud"

rsource "Kconfig.nrf_cloud_client_id"

rsource "Kconfig.nrf_cloud_mqtt"

rsource "Kconfig.nrf_cloud_fota"

rsource "Kconfig.nrf_cloud_agnss"

rsource "Kconfig.nrf_cloud_pgps"

rsource "Kconfig.nrf_cloud_rest"

rsource "Kconfig.nrf_cloud_location"

rsource "Kconfig.nrf_cloud_alert"

rsource "Kconfig.nrf_cloud_log"

rsource "Kconfig.nrf_cloud_coap"

rsource "Kconfig.nrf_cloud_shadow_info"

config NRF_CLOUD_GATEWAY
	bool "nRF Cloud Gateway"
	help
	  Enables functionality in this device to be compatible with
	  nRF Cloud LTE gateway support.

if NRF_CLOUD_MQTT || NRF_CLOUD_REST || NRF_CLOUD_PGPS || NRF_JWT || NRF_CLOUD_COAP

config NRF_CLOUD_HOST_NAME
	string "nRF Cloud server hostname"
	default "mqtt.nrfcloud.com"
	help
	  Used for MQTT and JITP performed with REST

config NRF_CLOUD_SEC_TAG
	int "Security tag to use for nRF Cloud connection"
	default 16842753

config NRF_CLOUD_CHECK_CREDENTIALS
	bool "Enable the ability to check if nRF Cloud credentials are present"
	select MODEM_KEY_MGMT if NRF_MODEM_LIB

config NRF_CLOUD_DEVICE_STATUS_ENCODE_VOLTAGE
	bool "Include the (battery) voltage when encoding device status"
	depends on MODEM_INFO
	depends on MODEM_INFO_ADD_DEVICE
	default y

choice NRF_CLOUD_WIFI_LOCATION_ENCODE_OPT
	prompt "Encoding options for Wi-Fi location requests"
	default NRF_CLOUD_WIFI_LOCATION_ENCODE_OPT_MAC_RSSI

config NRF_CLOUD_WIFI_LOCATION_ENCODE_OPT_MAC_ONLY
	bool "Encode only the MAC address"
	help
		The MAC address is the only required parameter.

config NRF_CLOUD_WIFI_LOCATION_ENCODE_OPT_MAC_RSSI
	bool "Encode the MAC address and the RSSI value"
	help
		The RSSI value may improve location accuracy.

config NRF_CLOUD_WIFI_LOCATION_ENCODE_OPT_ALL
	bool "Encode all available parameters"
	help
		This option increases the memory required for creating requests.
		It also increases the amount of data sent to nRF Cloud.
endchoice

choice NRF_CLOUD_JWT_GEN_METHOD
	prompt "How nRF Cloud JWTs are generated"
	default NRF_CLOUD_JWT_GEN_METHOD_MODEM

config NRF_CLOUD_JWT_GEN_METHOD_MODEM
	depends on NRF_JWT_MODEM
	bool "JWT generated by the modem"

config NRF_CLOUD_JWT_GEN_METHOD_PSA
	depends on NRF_JWT_PSA
	bool "JWT generated using PSA"

config NRF_CLOUD_JWT_GEN_METHOD_DER
	depends on NRF_JWT_DER
	bool "JWT generated using raw key"
endchoice

if NRF_CLOUD_JWT_GEN_METHOD_PSA
config NRF_CLOUD_JWT_PSA_KEY_ID
	int "Key id containing nRF Cloud JWT signing key"
	default 100
endif

config NRF_CLOUD_CERTIFICATES_FILE
	string "nRF Cloud certificates"
	depends on NRF_CLOUD_PROVISION_CERTIFICATES || NRF_CLOUD_COAP_WIFI_ADD_CREDS_FROM_FILE
	default "../include/nrf_cloud-certs.h"
	help
	  The default path for a header file that contains definitions for certificates that are
	  used during run-time provisioning of TLS credentials.
	  By default, the library expects the credentials to be in
	  Privacy Enhanced Mail (PEM) format. See "nrf_cloud-certs.h" for a template.

endif

if NRF_CLOUD_AGNSS || NRF_CLOUD_PGPS

module = NRF_CLOUD_GPS
module-str = nRF Cloud GPS Assistance
source "subsys/logging/Kconfig.template.log_config"

endif

module=NRF_CLOUD
module-dep=LOG
module-str=Log level for nRF Cloud
module-help=Enables nRF Cloud log messages.
source "subsys/logging/Kconfig.template.log_config"

endmenu
```

## subsys/net/lib/nrf_cloud/Kconfig.nrf_cloud_coap
```kconfig
# Copyright (c) 2023 Nordic Semiconductor
#
# SPDX-License-Identifier: LicenseRef-Nordic-5-Clause
#

menuconfig NRF_CLOUD_COAP
	bool "nRF Cloud COAP"
	select CJSON_LIB
	select ZCBOR
	select COAP
	select COAP_EXTENDED_OPTIONS_LEN
	select COAP_CLIENT
	select EXPERIMENTAL
	select LTE_PROPRIETARY_PSM_REQ if SOC_NRF9161_LACA

if NRF_CLOUD_COAP

config NRF_CLOUD_COAP_SERVER_HOSTNAME
	string "CoAP server hostname"
	default "coap.nrfcloud.com"

config NRF_CLOUD_COAP_SEC_TAG
	int "Security tag for credentials"
	default NRF_CLOUD_SEC_TAG

config NRF_CLOUD_COAP_SERVER_PORT
	int "CoAP server port"
	default 5684

config NRF_CLOUD_COAP_GF_CONF
	bool "Enable configuration options for ground-fix requests"
	help
	  The initial release of CoAP for nRF Cloud did not provide a way to
	  configure the response; it defaulted to always returning the location
	  and method used to acquire the location. The cloud will soon support
	  configuration values do_reply, fallback, and hi_conf. When the cloud
	  support is ready, NRF_CLOUD_COAP_GF_CONF can be set true.

if WIFI

config NRF_CLOUD_COAP_SEND_SSIDS
	bool "Include access point SSIDs with scan results"
	default n
	help
	  The nRF Cloud Wi-Fi location service does not require the human-
	  readable SSIDs in order to determine the device location. It does
	  require the access point MAC addresses. By not including SSIDs
	  the amount of data sent to the cloud is greatly reduced.

config NRF_CLOUD_COAP_WIFI_ADD_CREDS_FROM_FILE
	select EXPERIMENTAL
	bool "Add CA and private key from included file"
	help
	  Enable run-time provisioning of CA and private key from the
	  certificates header file selected by using NRF_CLOUD_CERTIFICATES_FILE
	  Please note that this option stores your device's private key in unprotected memory.
	  It is not secure, and for testing purposes only.

endif

module = NRF_CLOUD_COAP
module-str = nRF Cloud COAP
source "subsys/logging/Kconfig.template.log_config"

endif # NRF_CLOUD_COAP
```

## subsys/net/lib/nrf_jwt/Kconfig
```kconfig
#
# Copyright (c) 2021 Nordic Semiconductor ASA
#
# SPDX-License-Identifier: LicenseRef-Nordic-5-Clause
#

menuconfig NRF_JWT
	bool "nRF JWT Library"

if NRF_JWT
config NRF_JWT_PSA
	bool "Enable JWT signing with PSA key"
	select BASE64
	select NRF_SECURITY
	select MBEDTLS_PSA_CRYPTO_C
	select MBEDTLS_ENABLE_HEAP
	select PSA_WANT_ALG_ECDSA
	select PSA_WANT_KEY_TYPE_ECC_KEY_PAIR
	select PSA_WANT_ECC_SECP_R1_256
	select PSA_WANT_ALG_SHA_256
	select CJSON_LIB
	depends on NEWLIB_LIBC
	depends on NEWLIB_LIBC_FLOAT_PRINTF

config NRF_JWT_DER
	bool "Enable JWT signing with raw key (DER)"
	select BASE64
	select TINYCRYPT
	select TINYCRYPT_SHA256
	select TINYCRYPT_ECC_DSA
	select TINYCRYPT_CTR_PRNG
	select TINYCRYPT_AES
	select CJSON_LIB
	depends on NEWLIB_LIBC
	depends on NEWLIB_LIBC_FLOAT_PRINTF

config NRF_JWT_MODEM
	bool "Enable JWT creation and signing in the modem"
	select MODEM_JWT

module=NRF_JWT
module-dep=LOG
module-str=nRF JWT
source "${ZEPHYR_BASE}/subsys/logging/Kconfig.template.log_config"

endif # NRF_JWT
```

## tests/subsys/net/lib/nrf_cloud/fota/testcase.yaml
```yaml
common:
  platform_allow: nrf9160dk/nrf9160/ns
  integration_platforms:
    - nrf9160dk/nrf9160/ns
  tags: ci_build nrf_cloud_test nrf_cloud_lib
tests:
  net.lib.nrf_cloud.fota:
    timeout: 60
```
