## CMakeLists.txt
```
#
# Copyright (c) 2018 Nordic Semiconductor
#
# SPDX-License-Identifier: LicenseRef-BSD-5-Clause-Nordic
#

cmake_minimum_required(VERSION 3.8.2)

include(../../cmake/boilerplate.cmake)

include($ENV{ZEPHYR_BASE}/cmake/app/boilerplate.cmake NO_POLICY_SCOPE)
project(asset_tracker)
zephyr_compile_definitions(PROJECT_NAME=${PROJECT_NAME})

# NORDIC SDK APP START
target_sources(app PRIVATE src/main.c)
# NORDIC SDK APP END
zephyr_include_directories(src)

# Include application events and configuration headers
zephyr_library_include_directories(
  src/orientation_detector
  src/ui
  src/cloud_codec
  src/env_sensors
  src/light_sensor
  )

# Application sources
add_subdirectory(src/orientation_detector)
add_subdirectory(src/ui)
add_subdirectory(src/cloud_codec)
add_subdirectory(src/gps_controller)
add_subdirectory(src/env_sensors)
add_subdirectory_ifdef(CONFIG_BH1749 src/light_sensor)

if (CONFIG_USE_BME680_BSEC)
  target_link_libraries(app PUBLIC bsec_lib)
endif()
```

## Kconfig
```
#
# Copyright (c) 2018 Nordic Semiconductor ASA
#
# SPDX-License-Identifier: LicenseRef-BSD-5-Clause-Nordic
#

menu "Asset tracker"

rsource "src/ui/Kconfig"

config APPLICATION_WORKQUEUE_STACK_SIZE
	int "Application workqueue stack size"
	default 4096

config APPLICATION_WORKQUEUE_PRIORITY
	int "Application workqueue priority"
	default SYSTEM_WORKQUEUE_PRIORITY

menu "GPS"

choice
	prompt "GPS device"
	default GPS_USE_SIM
	help
	  Select from which device GPS data will be fetched.

config GPS_USE_SIM
	bool "Use GPS simulator"
	select GPS_SIM
	select GPS_SIM_TRIGGER
	help
	  Use simulated GPS data.

config GPS_USE_EXTERNAL
	bool "User provided GPS device"
	help
	  Provide a GPS device that location data will be fetched from and
	  sent to nRF Cloud

endchoice

config GPS_DEV_NAME
	string "GPS device name"
	default GPS_SIM_DEV_NAME if GPS_USE_SIM
	help
	  GPS device from which location data will be fetched and sent
	  to nRF Cloud.

config GPS_CONTROL_ON_LONG_PRESS
	bool "Control the GPS state with button"
	default y
	help
	  Control the GPS operation with long-press on the button.
	  Press for 5 seconds to enable, or 5 seconds to disable.

config GPS_CONTROL_PSM_ENABLE_ON_START
	bool "Enable PSM when starting GPS"
	help
	  The nRF9160 modem needs to be set in PSM mode for the GPS to start
	  searching for satellites. Enabling this option will do so
	  automatically, otherwise the application must handle it.

config GPS_CONTROL_PSM_DISABLE_ON_STOP
	bool "Disable PSM when stopping GPS"
	help
	  Selecting this option will disable PSM when the GPS is stopped.
	  During a PSM interval, the device is not reachable from the outside
	  until the interval times out, or the device itself attempts to
	  send data on the link.

config GPS_CONTROL_FIRST_FIX_CHECK_DELAY
	int "Time from Cloud conenction until first fix check"
	default 30
	help
	  The amount of time that should pass between successfully establishing
	  connection to cloud until first attempt to get position fix.
	  Attempting to get a fix means entering PSM mode, in which the device
	  is not reachable for the duration of the interval, or until the
	  device itself sends data and then for the duration for the set
	  active time thereafter.

config GPS_CONTROL_FIX_CHECK_INTERVAL
	int "Interval in seconds to between check for position fix"
	default 120
	help
	  The fix check interval gives the interval for how long it will go
	  between each retry to achieve position fix. The actual fix time will
	  vary with factors such as satellite coverage, surrounding buildings
	  and landscape, PSM interval and activity time requested and granted
	  by the network.

config GPS_CONTROL_FIX_CHECK_OVERDUE
	int "Longest allowed time in seconds between checks for position fix"
	default 900
	help
	  The fix check interval gives the interval for how long it will go
	  between each retry to achieve position fix, when GPS_START_ON_MOTION
	  enabled, even if no motion is detected.

config GPS_CONTROL_FIX_TRY_TIME
	int "Time in seconds to try to get fix"
	default 180
	help
	  Amount of time the device will attempt to get position fix. Note that
	  if the interval is interrupted by the device sending data, the timer
	  is not reset, and the actual try time will be shortened due to
	  the device not being in PSM mode all the time. If fix is not acquired
	  before it times out, the device will try to get fix again in
	  GPS_CONTROL_FIX_CHECK_INTERVAL seconds. If GPS_CONTROL_FIX_COUNT is reached
	  before the full GPS_CONTROL_FIX_TRY_TIME has passed, the GPS will be stopped.

config GPS_CONTROL_FIX_COUNT
	int "Number of position fix before stopping GPS"
	default 3
	help
	  The number of fixes to get before stopping the GPS, within the time
	  set in GPS_CONTROL_FIX_CHECK_INTERVAL.

config GPS_CONTROL_MAX_FAILED_FIX_ATTEMPTS
	int "Number of failed fix attempts before stopping GPS"
	default 3
	help
	  Number of retries to get fix before shutting down the GPS until user
	  input tells it to start retrying.

config GPS_START_ON_MOTION
	bool "Motion triggered GPS update"
	default n
	help
	  When accelerometer detects movement, and GPS is enabled, update GPS
	  position, but if no movement, wait a longer delay between updates
	  to conserve power.

endmenu # GPS

menu "Device and modem"

config POWER_OPTIMIZATION_ENABLE
	bool "Enable power optimization"
	default y
	select LTE_EDRX_REQ

if MODEM_INFO

config HOLD_TIME_RSRP
	int "Minimum time [s] between RSRP subscription messages"
	default 60
	help
	  The minimum time in seconds where the modem
	  informer is allowed to submit RSRP data to the cloud.

endif

endmenu # Device

menuconfig MOTION
	bool "Enable motion sensing in Asset Tracker"
	default y
	help
	  Enables motion sensing in asset tracker with real
	  sensors or simulated ones.

if MOTION

choice
	prompt "Accelerometer device"
	default ACCEL_USE_SIM
	help
	  Select which device will provide accelerometer data.

config ACCEL_USE_SIM
	bool "Use simulated accelerometer data"
	select SENSOR
	select SENSOR_SIM
	select SENSOR_SIM_TRIGGER
	select SENSOR_SIM_STATIC_VALUES
	help
	  Use sensor simulator to generate accelerometer data for
	  flip detection data sent to nRF Cloud.

config ACCEL_USE_EXTERNAL
	bool "User provided accelerometer device"
	help
	  The user will provide an accelerometer device that will
	  be used for flip detection.

endchoice

if ACCEL_USE_SIM
config ACCEL_DEV_NAME
	string
	default SENSOR_SIM_DEV_NAME

config ACCEL_TRIGGER
	bool
	default SENSOR_SIM_TRIGGER

config FLIP_INPUT
	int "Button or switch number to simulate flip"
	range 1 4 if BOARD_NRF9160DK_NRF9160NS
	range 1 1 if BOARD_THINGY91_NRF9160NS
	default 3 if BOARD_NRF9160DK_NRF9160NS
	default 1 if BOARD_THINGY91_NRF9160NS
	help
	  Button or switch number to use for simulating
	  a board flip event.
	  1 - Button 1
	  2 - Button 2
	  3 - Switch 1
	  4 - Switch 2
endif

if ACCEL_USE_EXTERNAL

config ACCEL_DEV_NAME
	string "Accelerometer device name"
	help
	  Device from which accelerometer data will be fetched and used
	  for orientation detection and sent to nRF Cloud.

endif

config ACCEL_INVERTED
	bool "Accelerometer inverted"
	default y if BOARD_THINGY91_NRF9160NS
	help
	  Enable if the accelerometer is mounted with the top side facing
	  down when the board itself is in normal position.

endif # MOTION

menu "Cloud"

config MQTT_KEEPALIVE
	int "Time after last transmission to send a ping to keep connection on"
	default 1200
	help
	  This should be set to the expected time between messages sent from
	  this device. Making it larger than the expected data period does not
	  conserve bandwidth, as the ping is only sent if nothing else
	  has been within the specified period. Shorter values can prevent hidden
	  NAT timeouts at the carrier, but also will interrupt GPS fix attempts
	  and slow down TTFF.

config CLOUD_BUTTON
	bool "Enable button sensor"
	default y

config CLOUD_BUTTON_INPUT
	int "Set button sensor button number"
	range 1 4 if BOARD_NRF9160DK_NRF9160NS
	range 1 1 if BOARD_THINGY91_NRF9160NS
	default 1

config CLOUD_CONNECT_RETRY_DELAY
	int "Cloud connection retry delay in seconds"
	default 480
	help
	  Time to wait before trying to reconnect to the cloud if the
	  previous attempt failed (in seconds).

config CLOUD_CONNECT_COUNT_MAX
	int "Maximum number of cloud connection attempts"
	default 8
	help
	  Maximum number of unsuccessful cloud connection attempts.
	  Device will wait for the value defined by CLOUD_CONNECT_RETRY_DELAY
	  between attempts.

config CLOUD_WAIT_DURATION
	int "Cloud connection acknowledge wait duration"
	default 30
	help
	  How long the device should wait for a CONNACK
	  event from the cloud when connecting.  Device will reboot
	  if an ack is not received within the duration.

config CLOUD_FOTA_APP
	bool "Enable firmware over-the-air upgrades for application"
	depends on AWS_FOTA || NRF_CLOUD_FOTA
	depends on DFU_TARGET_MCUBOOT
	default y

config CLOUD_FOTA_MODEM
	bool "Enable firmware over-the-air upgrades for modem"
	depends on AWS_FOTA || NRF_CLOUD_FOTA
	depends on DFU_TARGET_MODEM
	default y

config CLOUD_FOTA_BOOT
	bool "Enable firmware over-the-air upgrades for bootloader"
	depends on AWS_FOTA
	depends on DFU_TARGET_MCUBOOT
	depends on SECURE_BOOT
	default y

config CLOUD_CONNECT_ERR_REBOOT_S
	int "Seconds to wait before rebooting when a cloud connect error occurs"
	default 300

endmenu # Cloud

menuconfig ENVIRONMENT_SENSORS
	bool "Enable environment sensing in Asset Tracker"
	default y
	help
	  Enables environment sensing in asset tracker with real
	  sensors or simulated ones.

if ENVIRONMENT_SENSORS

config USE_BME680_BSEC
	bool "Use Bosch BME680 BSEC lib"
	default n
	help
	  Enable use of Bosch BSEC library. The library itself is not a part of
	  NCS and must be downloaded from Bosch Sensortec.

config BOSCH_BSEC_LIBRARY_PATH
	string "Path to Bosch BSEC library folder"
	default "$(ZEPHYR_BASE)/../nrf/ext/BSEC_1.4.8.0_Generic_Release"
	help
	  Path to the folder where the Bosch BSEC library is placed.

config ENVIRONMENT_DATA_SEND_INTERVAL
	int "Interval in seconds for sending environment data"
	default 30
	help
	  Interval between each sampling and sending of environment sensor data.
	  If the GPS is active, sensor data will not be sent before it is
	  stopped. The unit is seconds.

config ENVIRONMENT_DATA_BACKOFF_TIME
	int "Time to delay sending environment data if GPS active"
	default 20
	help
	  Time in seconds before retrying to send environment sensor data if
	  the GPS is active.

choice
	prompt "Temperature measurement device"
	default TEMP_USE_SIM
	help
	  Select which device will provide temperature data.

config TEMP_USE_SIM
	bool "Use simulated temperature data"
	select SENSOR
	select SENSOR_SIM
	help
	  Use sensor simulator to generate temperature data to send to
	  nRF Cloud.

config TEMP_USE_EXTERNAL
	bool "User provided temperature device"
	help
	  The user provides a temperature device that is
	  used for temperature measurement.

endchoice

if TEMP_USE_SIM
config TEMP_DEV_NAME
	string
	default SENSOR_SIM_DEV_NAME

config TEMP_TRIGGER
	bool
	default SENSOR_SIM_TRIGGER

config TEMP_SIM_BUTTON
	int "Button or switch to trigger 'data ready' event"
	range 1 4 if BOARD_NRF9160DK_NRF9160NS
	range 1 1 if BOARD_THINGY91_NRF9160NS
	default 3 if BOARD_NRF9160DK_NRF9160NS
	default 1 if BOARD_THINGY91_NRF9160NS
	help
	  Button or switch number to use for triggering
	  a 'data ready' event.
	  1 - Button 1
	  2 - Button 2
	  3 - Switch 1
	  4 - Switch 2
endif

if TEMP_USE_EXTERNAL

config TEMP_DEV_NAME
	string "Temperature device name"
	help
	  Device from which temperature data will be fetched and
	  sent to nRF Cloud.

endif

endif # ENVIRONMENT_SENSORS

menuconfig LIGHT_SENSOR
	bool "Light sensor"
	select BH1749 if BOARD_THINGY91_NRF9160NS
	default y if BOARD_THINGY91_NRF9160NS

if LIGHT_SENSOR

config LIGHT_SENSOR_DEV_NAME
	string "Light sensor device name"
	default "BH1749" if BOARD_THINGY91_NRF9160NS

config LIGHT_SENSOR_DATA_SEND_INTERVAL
	int "Interval in seconds for sending light sensor data"
	default 60
	help
	  Interval between each sampling and sending of light sensor data.
	  If the GPS is active, sensor data will not be sent before it is
	  stopped. The unit is seconds.

endif # LIGHT_SENSOR

config GPS_START_AFTER_CLOUD_EVT_READY
	bool "Automatic start of GPS on CLOUD_EVT_READY event after reset"
	default n
	help
	  Enabling this will make the GPS automatically start after a reset.
	  Useful when operating as a GPS tracker outdoors for a longer period
	  of time.

config ASSET_TRACKER_WATCHDOG_TIMEOUT_MSEC
	int "Watchdog timeout in milliseconds"
	default 60000

config USE_AT_HOST
	bool "Enable AT commands"
	default y
	select AT_HOST_LIBRARY
	help
	  Enable the AT host library so that AT commands can be sent to and
	  received from a serial terminal.

endmenu

menu "Zephyr Kernel"
source "Kconfig.zephyr"
endmenu

module = ASSET_TRACKER
module-str = Asset Tracker
source "${ZEPHYR_BASE}/subsys/logging/Kconfig.template.log_config"
```

## prj.conf
```kconfig
#
# Copyright (c) 2019 Nordic Semiconductor ASA
#
# SPDX-License-Identifier: LicenseRef-Nordic-5-Clause
#
# General config
CONFIG_NEWLIB_LIBC=y
CONFIG_NEWLIB_LIBC_FLOAT_PRINTF=y
CONFIG_ASSERT=y
CONFIG_REBOOT=y
CONFIG_LOG=y
CONFIG_LOG_MODE_IMMEDIATE=y

# Network
CONFIG_NETWORKING=y
CONFIG_NET_NATIVE=n
CONFIG_NET_SOCKETS=y
CONFIG_NET_SOCKETS_OFFLOAD=y

# LTE link control
CONFIG_POWER_OPTIMIZATION_ENABLE=n
CONFIG_LTE_LINK_CONTROL=y
CONFIG_LTE_NETWORK_MODE_LTE_M_GPS=y
CONFIG_LTE_AUTO_INIT_AND_CONNECT=n

CONFIG_LTE_NETWORK_MODE_NBIOT_GPS=n
CONFIG_LTE_PSM_REQ_RPTAU="00000110"
CONFIG_LTE_PSM_REQ_RAT="00000010"

# Modem info
CONFIG_MODEM_INFO=y
CONFIG_MODEM_INFO_ADD_DATE_TIME=n

# Modem library
CONFIG_NRF_MODEM_LIB=y
CONFIG_NRF_MODEM_LIB_TRACE_ENABLED=n

# nRF Cloud
CONFIG_CLOUD_API=y
CONFIG_NRF_CLOUD=y
CONFIG_NRF_CLOUD_MQTT=y
CONFIG_NRF_CLOUD_CLIENT_ID_SRC_INTERNAL_UUID=y
CONFIG_MODEM_ATTEST_TOKEN=y
CONFIG_NRF_CLOUD_LOG_LEVEL_DBG=y
CONFIG_NRF_CLOUD_AGPS=y
CONFIG_NRF_CLOUD_CONNECTION_POLL_THREAD=y
CONFIG_NRF_CLOUD_SEND_TIMEOUT=y
CONFIG_NRF_CLOUD_SEND_TIMEOUT_SEC=60
CONFIG_NRF_CLOUD_FOTA_LOG_LEVEL_DBG=y
# nRF Cloud FOTA download configuration
CONFIG_DOWNLOAD_CLIENT_STACK_SIZE=4096
# Needed for the cloud codec
CONFIG_CJSON_LIB=y
# Shorter to prevent NAT timeouts
CONFIG_MQTT_KEEPALIVE=120
# Don't resubscribe to topics if broker remembers them
CONFIG_MQTT_CLEAN_SESSION=n

# Sensors
CONFIG_ACCEL_USE_SIM=y
CONFIG_TEMP_USE_SIM=y
CONFIG_CLOUD_BUTTON=n

# GPS
CONFIG_NRF9160_GPS=y
# CONFIG_GPS_USE_SIM=y
CONFIG_NRF9160_GPS_LOG_LEVEL_DBG=y
CONFIG_GPS_USE_EXTERNAL=y
CONFIG_GPS_DEV_NAME="NRF9160_GPS"
CONFIG_GPS_CONTROL_PSM_ENABLE_ON_START=y

CONFIG_GPS_CONTROL_FIRST_FIX_CHECK_DELAY=10
CONFIG_GPS_CONTROL_FIX_CHECK_INTERVAL=30
CONFIG_GPS_CONTROL_FIX_TRY_TIME=360
CONFIG_GPS_CONTROL_PSM_DISABLE_ON_STOP=n
CONFIG_AGPS=y

# Library for buttons and LEDs
CONFIG_DK_LIBRARY=y
CONFIG_DK_LIBRARY_INVERT_LEDS=n

# Library that maintains the current date time UTC.
CONFIG_DATE_TIME=y

# Console
CONFIG_CONSOLE_SUBSYS=y
CONFIG_CONSOLE_HANDLER=y
CONFIG_CONSOLE_GETCHAR=y

# Heap and stacks
CONFIG_HEAP_MEM_POOL_SIZE=16384
CONFIG_MAIN_STACK_SIZE=8192
CONFIG_SYSTEM_WORKQUEUE_STACK_SIZE=2048

# Settings
CONFIG_FLASH=y
CONFIG_FLASH_PAGE_LAYOUT=y
CONFIG_FLASH_MAP=y
CONFIG_FCB=y
CONFIG_SETTINGS=y
CONFIG_SETTINGS_FCB=y
CONFIG_MPU_ALLOW_FLASH_WRITE=y

# MCUBOOT
CONFIG_BOOTLOADER_MCUBOOT=y
CONFIG_IMG_MANAGER=y
CONFIG_MCUBOOT_IMG_MANAGER=y
CONFIG_IMG_ERASE_PROGRESSIVELY=y

# Fatal error
CONFIG_RESET_ON_FATAL_ERROR=n
CONFIG_WATCHDOG=y
```

## lwm2m_carrier_overlay.conf
```kconfig
# To build asset tracker with LWM2M carrier lib support
# add the following to your west build command:
#       -DOVERLAY_CONFIG=lwm2m_carrier_overlay.conf
#
# Inspect the build output to ensure there are
# no Kconfig warnings indicating that LWM2M_CARRIER
# got the value 'n'.

CONFIG_LWM2M_CARRIER=y

# LWM2M Carrier requires newlib
CONFIG_NEWLIB_LIBC=y
CONFIG_NEWLIB_LIBC_FLOAT_PRINTF=y

# Disable autoconnect
CONFIG_BSD_LIBRARY_SYS_INIT=n
CONFIG_LTE_AUTO_INIT_AND_CONNECT=n

# Download client for the DFU
CONFIG_DOWNLOAD_CLIENT=y
CONFIG_DOWNLOAD_CLIENT_TLS=y

# PDN management support
CONFIG_PDN_MANAGEMENT=y

# AT Command driver interface with Modem
CONFIG_AT_CMD=y
CONFIG_AT_CMD_PARSER=y
CONFIG_MODEM_INFO_BUFFER_SIZE=512

# Non-volatile Storage
CONFIG_FLASH=y
CONFIG_FLASH_PAGE_LAYOUT=y
CONFIG_NVS=y
CONFIG_MPU_ALLOW_FLASH_WRITE=y

# Modem key manangement
CONFIG_MODEM_KEY_MGMT=y
```

## prj_thingy91_nrf9160ns.conf
```kconfig
#
# Copyright (c) 2019 Nordic Semiconductor ASA
#
# SPDX-License-Identifier: LicenseRef-BSD-5-Clause-Nordic
#
# General config
CONFIG_NEWLIB_LIBC=y
CONFIG_NEWLIB_LIBC_FLOAT_PRINTF=y
CONFIG_ASSERT=y
CONFIG_REBOOT=y
CONFIG_LOG=y
CONFIG_LOG_IMMEDIATE=y

# Network
CONFIG_NETWORKING=y
CONFIG_NET_NATIVE=n
CONFIG_NET_SOCKETS=y
CONFIG_NET_SOCKETS_OFFLOAD=y

# LTE link control
CONFIG_POWER_OPTIMIZATION_ENABLE=n
CONFIG_LTE_LINK_CONTROL=y
CONFIG_LTE_NETWORK_MODE_LTE_M_GPS=y
CONFIG_LTE_AUTO_INIT_AND_CONNECT=n

CONFIG_LTE_NETWORK_MODE_NBIOT=n
CONFIG_LTE_LEGACY_PCO_MODE=n
CONFIG_LTE_PSM_REQ_RPTAU="00000110"
CONFIG_LTE_PSM_REQ_RAT="00000010"

CONFIG_LTE_LOCK_BANDS=y
# Enable band 2, 3, 4, 8, 12, 13 ,20 and 28
CONFIG_LTE_LOCK_BAND_MASK="1000000010000001100010001110"

# Modem info
CONFIG_MODEM_INFO=y
CONFIG_MODEM_INFO_ADD_DATE_TIME=n

# Modem library
CONFIG_NRF_MODEM_LIB=y
CONFIG_NRF_MODEM_LIB_TRACE_ENABLED=n

# nRF Cloud
CONFIG_CLOUD_API=y
CONFIG_NRF_CLOUD=y
CONFIG_NRF_CLOUD_LOG_LEVEL_DBG=y
CONFIG_NRF_CLOUD_AGPS=y
CONFIG_NRF_CLOUD_CONNECTION_POLL_THREAD=y
CONFIG_NRF_CLOUD_SEND_TIMEOUT=y
CONFIG_NRF_CLOUD_SEND_TIMEOUT_SEC=60
CONFIG_NRF_CLOUD_FOTA_LOG_LEVEL_DBG=y
# nRF Cloud FOTA download configuration
CONFIG_DOWNLOAD_CLIENT_STACK_SIZE=4096
# Needed for the cloud codec
CONFIG_CJSON_LIB=y
# Shorter to prevent NAT timeouts
CONFIG_MQTT_KEEPALIVE=120
# Don't resubscribe to topics if broker remembers them
CONFIG_MQTT_CLEAN_SESSION=n

# Sensors
CONFIG_SENSOR=y
CONFIG_ACCEL_USE_EXTERNAL=y
CONFIG_ACCEL_DEV_NAME="ADXL362"
CONFIG_ADXL362=y
CONFIG_ADXL362_TRIGGER_GLOBAL_THREAD=y
CONFIG_ADXL362_ABS_REF_MODE=1
CONFIG_ADXL362_ACTIVITY_THRESHOLD=200
CONFIG_ADXL362_INACTIVITY_THRESHOLD=200
CONFIG_ADXL362_INTERRUPT_MODE=1
CONFIG_TEMP_USE_EXTERNAL=y
CONFIG_TEMP_DEV_NAME="BME680"

# Deselect CONFIG_BME680 if CONFIG_USE_BME680_BSEC is selected
CONFIG_BME680=y
CONFIG_USE_BME680_BSEC=n

# GPS
CONFIG_NRF9160_GPS_LOG_LEVEL_DBG=y
CONFIG_NRF9160_GPS=y
CONFIG_NRF9160_GPS_LOG_LEVEL_DBG=y
CONFIG_GPS_USE_EXTERNAL=y
CONFIG_GPS_DEV_NAME="NRF9160_GPS"
CONFIG_GPS_CONTROL_PSM_ENABLE_ON_START=y

CONFIG_GPS_CONTROL_FIRST_FIX_CHECK_DELAY=10
CONFIG_GPS_CONTROL_FIX_CHECK_INTERVAL=30
CONFIG_GPS_CONTROL_FIX_TRY_TIME=360
CONFIG_GPS_CONTROL_PSM_DISABLE_ON_STOP=n
CONFIG_GPS_START_ON_MOTION=y
CONFIG_AGPS=y
#CONFIG_AGPS_SINGLE_CELL_ONLY=y

# Library for buttons and LEDs
CONFIG_DK_LIBRARY=y
CONFIG_DK_LIBRARY_INVERT_LEDS=n

# Library that maintains the current date time UTC.
CONFIG_DATE_TIME=y

# Console
CONFIG_CONSOLE_SUBSYS=y
CONFIG_CONSOLE_HANDLER=y
CONFIG_CONSOLE_GETCHAR=y

# Heap and stacks
CONFIG_HEAP_MEM_POOL_SIZE=16384
CONFIG_MAIN_STACK_SIZE=8192
CONFIG_SYSTEM_WORKQUEUE_STACK_SIZE=2048

# Settings
CONFIG_FLASH=y
CONFIG_FLASH_PAGE_LAYOUT=y
CONFIG_FLASH_MAP=y
CONFIG_FCB=y
CONFIG_SETTINGS=y
CONFIG_SETTINGS_FCB=y
CONFIG_MPU_ALLOW_FLASH_WRITE=y

# MCUBOOT
CONFIG_BOOTLOADER_MCUBOOT=y
CONFIG_IMG_MANAGER=y
CONFIG_MCUBOOT_IMG_MANAGER=y
CONFIG_IMG_ERASE_PROGRESSIVELY=y

# Fatal error
CONFIG_RESET_ON_FATAL_ERROR=n
CONFIG_WATCHDOG=y
```

## src/bootstrap_psk.h
```c
/* 352656100432551:imeinumber102 */
/* 6bed44a215d8ff24ebb6ddb28fee3c48131594563ee59e58129896f4bc944426 */
static const char bootstrap_psk[] = { 0x6b, 0xed, 0x44, 0xa2, 0x15, 0xd8, 0xff, 0x24, 
                                      0xeb, 0xb6, 0xdd, 0xb2, 0x8f, 0xee, 0x3c, 0x48, 
                                      0x13, 0x15, 0x94, 0x56, 0x3e, 0xe5, 0x9e, 0x58, 
                                      0x12, 0x98, 0x96, 0xf4, 0xbc, 0x94, 0x44, 0x26 };

/* 352656100432551102 */
/* e0d97104e4ea3fede0c06a9d7db36f7b4784ec297e4795b16fde57f43dad5c47 */
/* ?? */
```

## src/sensor_channel_config.c
```c
/*
 * Copyright (c) 2019 Nordic Semiconductor ASA
 *
 * SPDX-License-Identifier: LicenseRef-BSD-5-Clause-Nordic
 */
#include "sensor_channel_config.h"

int sensor_ch_config_set_item( struct sensor_ch_cfg * const cfg,
		const enum sensor_ch_cfg_item_type type, const s32_t value)
{
	if ((type < SENSOR_CH_CFG_ITEM_TYPE__BEGIN) ||
		(type >= SENSOR_CH_CFG_ITEM_TYPE__END) ||
		(cfg == NULL)) {
		return -EINVAL;
	}

	cfg->value[type] = value;

	return 0;
}
```

## src/sensor_channel_config.h
```c
/*
 * Copyright (c) 2019 Nordic Semiconductor ASA
 *
 * SPDX-License-Identifier: LicenseRef-BSD-5-Clause-Nordic
 */

#ifndef SENSOR_CHANNEL_CONFIG_H__
#define SENSOR_CHANNEL_CONFIG_H__

#include <zephyr.h>

/**
 * @file sensor_channel_config.h
 *
 * @brief API to configure sensor channels for sending data to the cloud.
 * @defgroup sensor_channel_config API to configure sensor to cloud data.
 * @{
 */

enum sensor_ch_cfg_item_type {
	SENSOR_CH_CFG_ITEM_TYPE__BEGIN,

	SENSOR_CH_CFG_ITEM_TYPE_SEND_ENABLE = SENSOR_CH_CFG_ITEM_TYPE__BEGIN,
	SENSOR_CH_CFG_ITEM_TYPE_THRESH_LOW_VALUE,
	SENSOR_CH_CFG_ITEM_TYPE_THRESH_LOW_ENABLE,
	SENSOR_CH_CFG_ITEM_TYPE_THRESH_HIGH_VALUE,
	SENSOR_CH_CFG_ITEM_TYPE_THRESH_HIGH_ENABLE,

	SENSOR_CH_CFG_ITEM_TYPE__END
};

struct sensor_ch_cfg {
	s32_t value[SENSOR_CH_CFG_ITEM_TYPE__END];
};

int sensor_ch_config_set_item( struct sensor_ch_cfg * const cfg,
		const enum sensor_ch_cfg_item_type type, const s32_t value);

/** @} */

#endif /* SENSOR_CHANNEL_CONFIG_H__ */
```
